## drivers/input/touchscreen/moto/Kconfig
```kconfig
#
# motorola touchscreen driver configuration
#
config CHIPONE_MTK_CHECK_PANEL
	bool "Support mtk panel check"
	help
		Say Y here if support mtk panel check.

config CTS_INPUT_ENABLE_DOUBLE_TAP
	bool "Support touch wake gesture feature"
	help
		Say Y here if support touch wake gesture feature.

config CTS_LAST_TIME
	bool "Support get the timestamp of last touch event"
	help
		Say Y here if need to get the timestamp of last touch event.

config BOARD_USES_DOUBLE_TAP_CTRL
	bool "Support touch wake gesture feature"
	help
		Say Y here if support touch wake gesture feature.

config CHIPONE_LOG_CAPTURE
	bool "Support ghost log capture"
	help
		Say Y here if support touch ghost log capture.

config CHIPONE_FORCE_UP_ENABLE
	bool "Support touch force up"
	help
		Say Y here if support touch force up.

config MTK_PANEL_NOTIFICATIONS
	bool "set mtk panel notofications"
	help
		Say Y here if support mtk panel notofications.

config CHIPONE_CHECK_DEVICE_BOOTMODE
	bool "set device bootmode check"
	help
		Say Y here if support device bootmode check.

config CTS_NOTIFY_TOUCH_STATE
	bool "set touch state notofy"
	help
		Say Y here if support touch state notofy.

config STOWED_MODE_EN
	bool "set stowed mode enable"
	help
		Say Y here if support stowed mode.

config INPUT_CHIPONE_IC_NAME
	string "set touch ic name"
	help
		This config is set as project name for touch to select configuration.

config INPUT_FOCALTECH_IC_NAME
	string "set touch ic name"
	help
		This config is set as project name for touch to select configuration.

config FTS_MTK_CHECK_PANEL
	bool "Support mtk panel check"
	help
		Say Y here if support mtk panel check.

config INPUT_FOCALTECH_DEBUG_EN
	bool "set input focaltech debug enable"
	help
		Say Y here if support input focaltech debug enable.

config INPUT_FOCALTECH_0FLASH_MMI_ENABLE_DOUBLE_TAP
	bool "set input focaltec wake gesture feature"
	help
		Say Y here if support touch wake gesture feature.

config FTS_LAST_TIME
	bool "Support get the timestamp of last touch event"
	help
		Say Y here if need to get the timestamp of last touch event.

config FTS_IRQ_DIS_FOR_RESET
	bool "set fts irq disable for reset"
	help
		Say Y here if support fts irq disable for reset.

config FTS_STOWED_MODE_SUPPORT
	bool "set fts stowed mode enable"
	help
		Say Y here if support fts stowed mode.

config FTS_CHECK_DEVICE_BOOTMODE_SUPPORT
	bool "set fts device bootmode check"
	help
		Say Y here if support fts device bootmode check.

config FOCALTECH_LOG_CAPTURE
	bool "set fts log capture"
	help
		Say Y here if support fts log capture.

config FOCAL_SPI_DRIVE
	bool "set fts spi drive"
	help
		Say Y here if support fts spi drive.

config INPUT_HIGH_RESOLUTION_4
	bool "set fts input high resolution 4"
	help
		Say Y here if support fts input high resolution 4.

config TP_MTK_CHECK_PANEL
	bool "set ovt mtk check panel"
	help
		Say Y here if support ovt mtk check panel.

config OVT_ENABLE_DOUBLE_TAP
	bool "set ovt wake gesture feature"
	help
		Say Y here if support touch wake gesture feature.

config TP_LAST_TIME
	bool "Support get the timestamp of last touch event"
	help
		Say Y here if need to get the timestamp of last touch event.

config SUPPORT_MULTI_FIRMWARE
	bool "set ovt multi fireware support"
	help
		Say Y here if support ovt multi fireware.

config OVT_STOWED_MODE_SUPPORT
	bool "set ovt stowed mode enable"
	help
		Say Y here if support ovt stowed mode.

config OMN_LOG_CAPTURE
	bool "set ovt log capture"
	help
		Say Y here if support ovt log capture.

config OVT_PANEL_GESTURE_NOTIFY_SUPPORT
	bool "set ovt panel gesture notify support"
	help
		Say Y here if support ovt panel gesture notify.

config OVT_CHECK_DEVICE_BOOTMODE_SUPPORT
	bool "set ovt check device bootmode support"
	help
		Say Y here if support ovt check device bootmode.

config OVT_CHARGER_DETECT_SUPPORT
	bool "set ovt charger detect support"
	help
		Say Y here if support ovt charger detect.

config NOVA_MTK_CHECK_PANEL
	bool "set novatech check panel support"
	help
		Say Y here if there is support to novatech check panel.

config NOVA_TOUCH_LAST_TIME
	bool "set novatech touch last time"
	help
		Say Y here if there is support to novatech touch last time.

config NVT_LCM_ESD_NOTIFIER
	bool "set novatech lcm esd notifiers support"
	help
		Say Y here if there is support to novatech lcm esd notifier.

config NVT_ESD_RST_SUPPORT
	bool "set novatech esd reset support"
	help
		Say Y here if there is support to novatech esd reset.

config NOVA_CHECK_DEVICE_BOOTMODE
	bool "set novatech check device bootmode"
	help
		Say Y here if there is support to novatech check device bootmode.

config NOVA_NOVATEK_MTK_SPI
	bool "set novatech mtk spi"
	help
		Say Y here if there is support to novatech mtk spi.

config NVT_ESD_RECOVERY_SUPPORT
	bool "set novatech eds recovery support"
	help
		Say Y here if there is support to novatech eds recovery.

config STOWED_MODE_SUPPORT
	bool "set novatech stowed mode support"
	help
		Say Y here if there is support to novatech stowed mode support.

config INPUT_NOVA_0FLASH_MMI_ENABLE_DOUBLE_TAP
	bool "set novatech double tap"
	help
		Say Y here if there is support to novatech double tap.

config ILITEK_MTK_CHECK_PANEL
	bool "set ilitek mtk check panel"
	help
		Say Y here if there is support to ilitek mtk check panel.

config ILITEK_CHARGER
	bool "set ilitek charger support"
	help
		Say Y here if there is support to ilitek charger.

config INPUT_ILI_SET_TOUCH_STATE
	bool "set ilitek set touch state support"
	help
		Say Y here if there is support to ilitek set touch state.

config ILITEK_RESUME_BY_DDI
	bool "set ilitek resume by DDI"
	help
		Say Y here if there is support to ilitek resume by DDI.

config ILITEK_STOWED_MODE_SUPPORT
	bool "set ilitek stowed mode support"
	help
		Say Y here if there is support to ilitek stowed mode.

config INPUT_ILI_ENABLE_DOUBLE_TAP
	bool "set ilitek double tap"
	help
		Say Y here if there is support to ilitek double tap.

config ILI_TOUCH_LAST_TIME
	bool "set ilitek touch last time"
	help
		Say Y here if there is support to ilitek touch last time.
```

## drivers/spi/Kconfig
```kconfig
# SPDX-License-Identifier: GPL-2.0-only
#
# SPI driver configuration
#

if SPI

config DEVICE_MODULES_SPI_MT65XX
	tristate "MediaTek SPI controller"
	depends on ARCH_MEDIATEK || COMPILE_TEST
	help
	  This selects the MediaTek(R) SPI bus driver.
	  If you want to use MediaTek(R) SPI interface,
	  say Y or M here.If you are not sure, say N.
	  SPI drivers for Mediatek MT65XX and MT81XX series ARM SoCs.

endif # SPI

config MT6855_TWO_DEVICE_SPI_BUS_SUPPORT
	tristate "support two device on spi bus"
	depends on OF
	depends on DRM_MIPI_DSI
        default n
	help
	  To set spi bus support two device.
	  set N by default.
	  If spi bus need support two device on it, set Y in product dts.
```
